## iTop4412_Kernel_3.0/arch/arm/configs/fpga4212_defconfig
```kconfig
CONFIG_ARM_PATCH_PHYS_VIRT=y
CONFIG_EXPERIMENTAL=y
# CONFIG_SWAP is not set
CONFIG_SYSVIPC=y
CONFIG_CGROUPS=y
CONFIG_CGROUP_DEBUG=y
CONFIG_CGROUP_FREEZER=y
CONFIG_CGROUP_CPUACCT=y
CONFIG_RESOURCE_COUNTERS=y
CONFIG_CGROUP_SCHED=y
CONFIG_RT_GROUP_SCHED=y
CONFIG_BLK_DEV_INITRD=y
CONFIG_KALLSYMS_ALL=y
CONFIG_ASHMEM=y
# CONFIG_AIO is not set
CONFIG_EMBEDDED=y
# CONFIG_SLUB_DEBUG is not set
CONFIG_MODULES=y
CONFIG_MODULE_FORCE_LOAD=y
CONFIG_MODULE_UNLOAD=y
CONFIG_MODULE_FORCE_UNLOAD=y
# CONFIG_BLK_DEV_BSG is not set
CONFIG_ARCH_EXYNOS=y
CONFIG_ARCH_EXYNOS4=y
CONFIG_S3C_LOWLEVEL_UART_PORT=1
CONFIG_S3C_ADC=y
CONFIG_S3C_DEV_ADC1=y
CONFIG_MACH_FPGA4212=y
CONFIG_SWP_EMULATE=n
CONFIG_SMP=y
CONFIG_NR_CPUS=2
CONFIG_PREEMPT=y
CONFIG_AEABI=y
CONFIG_CMDLINE="root=/dev/ram0 rw ramdisk=8192 rootfstype=cramfs initrd=0x41000000,8M console=ttySAC1,115200 init=/linuxrc mem=256M"
CONFIG_VFP=y
CONFIG_NEON=y
# CONFIG_CORE_DUMP_DEFAULT_ELF_HEADERS is not set
CONFIG_BINFMT_MISC=y
# CONFIG_SUSPEND is not set
CONFIG_NET=y
CONFIG_PACKET=y
CONFIG_UNIX=y
CONFIG_NET_KEY=y
CONFIG_INET=y
CONFIG_INET_ESP=y
# CONFIG_INET_XFRM_MODE_TUNNEL is not set
# CONFIG_INET_XFRM_MODE_BEET is not set
# CONFIG_INET_LRO is not set
CONFIG_IPV6=y
CONFIG_IPV6_PRIVACY=y
CONFIG_IPV6_ROUTER_PREF=y
CONFIG_IPV6_OPTIMISTIC_DAD=y
CONFIG_INET6_AH=y
CONFIG_INET6_ESP=y
CONFIG_INET6_IPCOMP=y
CONFIG_IPV6_MIP6=y
CONFIG_IPV6_TUNNEL=y
CONFIG_IPV6_MULTIPLE_TABLES=y
CONFIG_NETFILTER=y
CONFIG_PHONET=y
CONFIG_NET_SCHED=y
CONFIG_UEVENT_HELPER_PATH="/sbin/hotplug"
CONFIG_BLK_DEV_LOOP=y
CONFIG_BLK_DEV_RAM=y
CONFIG_BLK_DEV_RAM_SIZE=8192
CONFIG_BLK_DEV_XIP=y
CONFIG_MISC_DEVICES=y
# CONFIG_ANDROID_PMEM is not set
CONFIG_KERNEL_DEBUGGER_CORE=y
CONFIG_UID_STAT=y
CONFIG_SCSI=y
CONFIG_BLK_DEV_SD=y
CONFIG_CHR_DEV_SG=y
CONFIG_INPUT_EVDEV=y
CONFIG_INPUT_KEYRESET=y
# CONFIG_INPUT_MOUSE is not set
CONFIG_INPUT_TOUCHSCREEN=y
CONFIG_INPUT_MISC=y
CONFIG_INPUT_KEYCHORD=y
CONFIG_INPUT_UINPUT=y
CONFIG_INPUT_GPIO=y
# CONFIG_VT is not set
# CONFIG_UNIX98_PTYS is not set
# CONFIG_LEGACY_PTYS is not set
CONFIG_SERIAL_8250=y
CONFIG_SERIAL_SAMSUNG=y
CONFIG_SERIAL_SAMSUNG_CONSOLE=y
CONFIG_HW_RANDOM=y
# CONFIG_HWMON is not set
# CONFIG_MFD_SUPPORT is not set
# CONFIG_HID_SUPPORT is not set
# CONFIG_USB_SUPPORT is not set
CONFIG_EXT2_FS=y
CONFIG_EXT4_FS=y
# CONFIG_EXT4_FS_XATTR is not set
# CONFIG_DNOTIFY is not set
CONFIG_FUSE_FS=y
CONFIG_MSDOS_FS=y
CONFIG_VFAT_FS=y
CONFIG_TMPFS=y
CONFIG_TMPFS_POSIX_ACL=y
CONFIG_CRAMFS=y
# CONFIG_NETWORK_FILESYSTEMS is not set
CONFIG_PARTITION_ADVANCED=y
CONFIG_EFI_PARTITION=y
CONFIG_NLS_CODEPAGE_437=y
CONFIG_NLS_ASCII=y
CONFIG_NLS_ISO8859_1=y
CONFIG_PRINTK_TIME=y
CONFIG_MAGIC_SYSRQ=y
CONFIG_DEBUG_FS=y
CONFIG_DEBUG_KERNEL=y
CONFIG_DETECT_HUNG_TASK=y
# CONFIG_DEBUG_PREEMPT is not set
CONFIG_DEBUG_RT_MUTEXES=y
CONFIG_DEBUG_SPINLOCK=y
CONFIG_DEBUG_MUTEXES=y
CONFIG_DEBUG_SPINLOCK_SLEEP=y
CONFIG_DEBUG_INFO=y
# CONFIG_RCU_CPU_STALL_DETECTOR is not set
CONFIG_SYSCTL_SYSCALL_CHECK=y
# CONFIG_ARM_UNWIND is not set
CONFIG_DEBUG_USER=y
CONFIG_DEBUG_S3C_UART=1
CONFIG_CRC_CCITT=y
```

## iTop4412_Kernel_3.0/drivers/i2c/chips/Kconfig
```kconfig
#
# Miscellaneous I2C chip drivers configuration
#

menu "Miscellaneous I2C Chip support"

config SENSOR_ROHM_BH1721
	tristate "Rohm BH1721 Light Sensor"
	depends on EXPERIMENTAL
	help
	  If you say yes here you get support for Rohm BH1721 Light Sensor.

endmenu
```

## iTop4412_Kernel_3.0/drivers/media/video/samsung/Kconfig
```kconfig
config VIDEO_SAMSUNG
	bool "Samsung Multimedia Devices"
	depends on VIDEO_CAPTURE_DRIVERS && VIDEO_V4L2
	select VIDEO_FIXED_MINOR_RANGES
	default n
	help
	  This is a representative video4linux configuration for Samsung multimedia devices.

config VIDEO_SAMSUNG_V4L2
	bool "V4L2 API for digital camera to be contributed by samsung"
	depends on VIDEO_DEV && VIDEO_SAMSUNG
	default n
	help
	  This feature is for new V4L2 APIs all about digital camera

if CPU_EXYNOS4210 || CPU_EXYNOS4212
	source "drivers/media/video/samsung/fimc/Kconfig"
	source "drivers/media/video/samsung/tvout/Kconfig"
	source "drivers/media/video/samsung/mfc5x/Kconfig"

endif


config VIDEO_FIMG2D
	bool
	select S5P_SYSTEM_MMU
	depends on VIDEO_SAMSUNG
	default n

config VIDEO_FIMG2D_DEBUG
	bool
	depends on VIDEO_FIMG2D
	default n

source "drivers/media/video/samsung/fimg2d3x/Kconfig"
source "drivers/media/video/samsung/fimg2d4x/Kconfig"
source "drivers/media/video/samsung/fimg2d_android/Kconfig"

if  TC4_GB	
	source "drivers/media/video/samsung/ump_gb/Kconfig"
	source "drivers/media/video/samsung/mali_gb/Kconfig"
endif

if TC4_ICS
	#source "drivers/media/video/samsung/ump_ics/Kconfig"
	#source "drivers/media/video/samsung/mali_ics/Kconfig"
#	source "drivers/media/video/samsung/ump_r3p1/Kconfig"
#	source "drivers/media/video/samsung/mali_r3p1/Kconfig"
	source "drivers/media/video/samsung/ump_r4p0/Kconfig"
	source "drivers/media/video/samsung/mali_r4p0/Kconfig"
endif


if CPU_EXYNOS4212 || CPU_EXYNOS5250
	source "drivers/media/video/samsung/jpeg/Kconfig"
	source "drivers/media/video/samsung/jpeg_v2x/Kconfig"
endif


if VIDEO_SAMSUNG
comment "Reserved memory configurations"
config VIDEO_SAMSUNG_MEMSIZE_FIMC0
	int "Memory size in kbytes for FIMC0"
	depends on VIDEO_FIMC || VIDEO_SAMSUNG_S5P_FIMC
	default "5120"

config VIDEO_SAMSUNG_MEMSIZE_FIMC1
	int "Memory size in kbytes for FIMC1"
	depends on VIDEO_FIMC || VIDEO_SAMSUNG_S5P_FIMC
	default "5120"

config VIDEO_SAMSUNG_MEMSIZE_FIMC2
	int "Memory size in kbytes for FIMC2"
	depends on VIDEO_FIMC || VIDEO_SAMSUNG_S5P_FIMC
	default "5120"

config VIDEO_SAMSUNG_MEMSIZE_FIMC3
	int "Memory size in kbytes for FIMC3"
	depends on VIDEO_FIMC || VIDEO_SAMSUNG_S5P_FIMC
	default "5120"

config VIDEO_SAMSUNG_MEMSIZE_MFC
	int "Memory size in kbytes for MFC"
	depends on ((VIDEO_MFC5X) && (VIDEO_MFC_MEM_PORT_COUNT = 1))
	default "65536"

config VIDEO_SAMSUNG_MEMSIZE_MFC0
	int "Memory size in kbytes for MFC port0"
	depends on ((VIDEO_MFC5X) && (!VIDEO_MFC_MEM_PORT_COUNT = 1))
	default "41984"

config VIDEO_SAMSUNG_MEMSIZE_MFC1
	int "Memory size in kbytes for MFC port1"
	depends on ((VIDEO_MFC5X) && (!VIDEO_MFC_MEM_PORT_COUNT = 1))
	default "41984"

config VIDEO_SAMSUNG_MEMSIZE_JPEG
	int "Memory size in kbytes for JPEG"
	depends on VIDEO_JPEG || VIDEO_JPEG_V2X
	default "40960"
config VIDEO_SAMSUNG_MEMSIZE_FIMG2D
	int "Memory size in kbytes for FIMG2D"
	depends on VIDEO_FIMG2D
	default "8192"	
endif
```

## iTop4412_Kernel_3.0/drivers/media/video/samsung/fimg2d_android/Kconfig
```kconfig
# drivers/media/video/samsung/g2d/Kconfig
#
# Copyright (c) 2010 Samsung Electronics Co., Ltd.
# 		http://www.samsung.com/
#
# Licensed under GPLv2

config GB_VIDEO_FIMG2D
	bool "Samsung Graphics 2D Driver"
	select VIDEO_FIMG2D
	depends on VIDEO_SAMSUNG && TC4_GB &&(CPU_EXYNOS4212 || CPU_EXYNOS4412 || CPU_EXYNOS5210 || CPU_EXYNOS5250)
	default n
	---help---
	  This is a graphics 2D (FIMG2D 4.x) driver for Samsung ARM based SoC.

config GB_VIDEO_FIMG2D_DEBUG
	bool "Enables FIMG2D debug messages"
	select VIDEO_FIMG2D_DEBUG
	depends on GB_VIDEO_FIMG2D
	default n
	---help---
	  This enables FIMG2D driver debug messages.
```

## iTop4412_Kernel_3.0/drivers/media/video/samsung/jpeg/Kconfig
```kconfig
#
# Configuration for JPEG
#

config VIDEO_JPEG
	bool "Samsung JPEG_v2.x driver"
	depends on (VIDEO_SAMSUNG && TC4_GB )
	default n
	---help---
	  This is a JPEG for Samsung S5PV210 or S5PV310

config VIDEO_JPEG_DEBUG
	bool "print JPEG debug message"
	depends on VIDEO_JPEG
	default n
```

## iTop4412_Kernel_3.0/drivers/media/video/samsung/mali_gb/Kconfig
```kconfig
#
## S3C Multimedia Mali configuration
##
#
# For Mali
config GB_VIDEO_MALI400MP
	bool "Enable MALI integration"
	depends on (VIDEO_SAMSUNG && TC4_GB)
	default y 
	---help---
                This enables MALI integration in the multimedia device driver

choice
depends on GB_VIDEO_MALI400MP
prompt "MALI MEMORY OPTION"
default GB_MALI_OSMEM_ONLY 
config GB_MALI_DED_ONLY
  bool "mali dedicated memory only"
   ---help---
       This enables MALI dedicated memory only option
config GB_MALI_DED_MMU
  bool "mali dedicated memory with mmu enable"
   ---help---
       This enables MALI dedicated memory with mmu enable option
config GB_MALI_OSMEM_ONLY
   bool "mali OS memory only"
   ---help---
       This enables MALI OS memory only option
config GB_MALI_DED_OSMEM
   bool "mali dedicated memory and OS memory"
   ---help---
       This enables MALI dedicated memory and OS memory option

endchoice
config GB_MALI_MEM_SIZE
int "Dedicated Memory Size"
   depends on GB_VIDEO_MALI400MP && (GB_MALI_DED_ONLY || GB_MALI_DED_MMU || GB_MALI_DED_OSMEM)
   default "128"
   ---help---
       This value is dedicated memory size of Mali GPU(unit is MByte).


# For DEBUG
config GB_VIDEO_MALI400MP_DEBUG
	bool "Enables debug messages"
	depends on GB_VIDEO_MALI400MP
	default n
	help
	  This enables Mali driver debug messages.

config GB_VIDEO_MALI400MP_DVFS
	bool "Enables DVFS"
	depends on GB_VIDEO_MALI400MP && PM 
	default y
	help
	  This enables Mali driver DVFS.
```

## iTop4412_Kernel_3.0/drivers/media/video/samsung/mali_r3p1/Kconfig
```kconfig
#
## S3C Multimedia Mali configuration
##
#
# For Mali
config MALI_400MP_UMP
	bool "Enable MALI integration"
	depends on VIDEO_SAMSUNG
	default y
	---help---
                This enables MALI integration in the multimedia device driver

choice
depends on MALI_400MP_UMP
prompt "MALI MEMORY OPTION"
default MALI_OSMEM_ONLY
config MALI_DED_ONLY
  bool "mali dedicated memory only"
   ---help---
       This enables MALI dedicated memory only option
config MALI_DED_MMU
  bool "mali dedicated memory with mmu enable"
   ---help---
       This enables MALI dedicated memory with mmu enable option
config MALI_OSMEM_ONLY
   bool "mali OS memory only"
   ---help---
       This enables MALI OS memory only option
config MALI_DED_OSMEM
   bool "mali dedicated memory and OS memory"
   ---help---
       This enables MALI dedicated memory and OS memory option

endchoice
config MALI_MEM_SIZE
int "Dedicated Memory Size"
   depends on MALI_400MP_UMP && (MALI_DED_ONLY || MALI_DED_MMU || MALI_DED_OSMEM)
   default "128"
   ---help---
       This value is dedicated memory size of Mali GPU(unit is MByte).
	   
config MALI_R3P1_LSI
	bool "Uses the R3P1 as a kernel module"
	depends on MALI_400MP_UMP
	default n
	---help---
        This uses the r3p1 as a MALI kernel module


# For DEBUG
config MALI_400MP_UMP_DEBUG
	bool "Enables debug messages"
	depends on MALI_400MP_UMP
	default n
	help
	  This enables Mali driver debug messages.

config MALI_400MP_UMP_DVFS
	bool "Enables DVFS"
	depends on MALI_400MP_UMP && PM 
	default y
	help
	  This enables Mali driver DVFS.
```

## iTop4412_Kernel_3.0/drivers/media/video/samsung/ump_gb/Kconfig
```kconfig
#
## S3C Multimedia Mali configuration
##
#
# For UMP
config GB_VIDEO_UMP
	bool "Enable UMP(Unified Memory Provider)"
	depends on (VIDEO_SAMSUNG  && TC4_GB)
	default y
	---help---
		This enables UMP memory provider

config GB_UMP_VCM_ALLOC
	depends on GB_VIDEO_UMP && VCM
	default y
        bool "Enable ump-vcm(virtual contiguous memory) memory"
        help
          Use VCM(virtual-contiguous-memory) to allocate physical memory.

choice
depends on GB_VIDEO_UMP
prompt "UMP MEMEMORY OPTION"
default GB_UMP_VCM_ONLY
config GB_UMP_DED_ONLY
  bool "ump dedicated memory only"
   ---help---
       This enables UMP dedicated memory only option
config GB_UMP_OSMEM_ONLY
   bool "ump OS memory only"
   ---help---
       This enables UMP OS memory only option
config GB_UMP_VCM_ONLY
   bool "ump VCM memory"
   ---help---
       This enables UMP VCM memory only option

endchoice
config GB_UMP_MEM_SIZE
int "UMP Memory Size"
   depends on GB_VIDEO_UMP 
   default "64"
   ---help---
       This value is dedicated memory size of UMP (unit is MByte).
# For UMP_DEBUG
config GB_VIDEO_UMP_DEBUG
	bool "Enables debug messages"
	depends on GB_VIDEO_UMP
	default n
	help
	  This enables UMP driver debug messages.
```

## iTop4412_Kernel_3.0/drivers/nfc/Kconfig
```kconfig
#
# Near Field Communication (NFC) devices
#

menuconfig NFC_DEVICES
	bool "Near Field Communication (NFC) devices"
	default y
	---help---
	  You'll have to say Y if your computer contains an NFC device that
	  you want to use under Linux.

	  You can say N here if you don't have any Near Field Communication
	  devices connected to your computer.

if NFC_DEVICES

config PN544_NFC
	tristate "PN544 NFC driver"
	depends on I2C
	select CRC_CCITT
	default n
	---help---
	  Say yes if you want PN544 Near Field Communication driver.
	  This is for i2c connected version. If unsure, say N here.

	  To compile this driver as a module, choose m here. The module will
	  be called pn544.

config S3FHRN2
	bool "Samsung NFC S3FHRN2 driver"
	depends on I2C
	default y
	---help---
	  You'll have to say Y if your system contains S3FHRN2 of SAMSUNG
	  NFC device.

	  This is for I2C or UART connected version. If unsure, say N here.

choice
	prompt "NFC Interface"
	depends on S3FHRN2
	default S3FHRN2_I2C

config S3FHRN2_I2C
	bool "I2C Interface"

config S3FHRN2_UART
	bool "UART Interface"
endchoice

config S3FHRN2_I2C_GPIO
	bool "With Bit Bang Algorithm"
	depends on S3FHRN2_I2C
	select I2C_ALGOBIT
	default n
	---help---
	  Say yes if you want use Bit Bang Algorithm without I2C controller

	  This is for smdk4x12 board. If unsure, say N here.

endif # NFC_DEVICES
```

## iTop4412_Kernel_3.0/drivers/topeet/Kconfig
```kconfig
menu "TOPEET COMPANY DECIDE CPU TYPE"
#
# COMBO chip configuration
#
config CPU_TYPE_SCP_ELITE
	bool "CPU type support 4412 SCP ELITE"
	default y
	help
	  select cpu type, if select support 4412 SCP ELITE
	  
config CPU_TYPE_SCP_SUPPER
	bool "CPU type support 4412 SCP SUPPER"
	default y
	help
	  select cpu type, if select support 4412 SCP SUPPER

	default y
	help
	  select cpu type, if select support 4412 SCP SUPPER
	  
config CPU_TYPE_POP_ELITE
	bool "CPU type support 4412 POP ELITE"
	default y
	help
	  select cpu type, if select support 4412 POP ELITE

	default y
	help
	  select cpu type, if select support 4412 POP ELITE
	  
config CPU_TYPE_POP_SUPPER
	bool "CPU type support 4412 POP SUPPER"
	default y
	help
	  select cpu type, if select support 4412 POP SUPPER


	default y
	help
	  select cpu type, if select support 4412 POP SUPPER

config CPU_TYPE_POP2G_ELITE
	bool "CPU type support 4412 POP 2G DDR ELITE"
	default y
	help
	  select cpu type, if select support 4412 POP 2G DDR ELITE

	default y
	help
	  select cpu type, if select support 4412 POP 2G DDR ELITE
	  
config CPU_TYPE_POP2G_SUPPER
	bool "CPU type support 4412 POP 2G DDR SUPPER"
	default y
	help
	  select cpu type, if select support 4412 POP 2G DDR SUPPER


	default y
	help
	  select cpu type, if select support 4412 POP 2G DDR  SUPPER	  

endmenu
```

## iTop4412_Kernel_3.0/sound/soc/samsung/srp/Kconfig
```kconfig
config SND_SAMSUNG_RP
	bool "SRP Audio support via Internal DMA"
	depends on SND_SOC_SAMSUNG_I2S_IDMA
	default n
	help
	  Say Y if you want to add support for SRP Audio.

config AUDIO_SAMSUNG_MEMSIZE_SRP
	int "Memory size in kbytes for SRP Audio"
	depends on SND_SAMSUNG_RP
	default "1024"

config SND_SAMSUNG_RP_DEBUG
	bool "Enable debug message for SRP Audio"
	depends on SND_SAMSUNG_RP
	default n
	help
	  Say Y if you want to add debug message for SRP Audio.
```
